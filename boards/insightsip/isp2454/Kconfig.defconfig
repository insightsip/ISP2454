## boards/insightsip/isp2454/Kconfig.defconfig
```kconfig
# Copyright (c) 2026 Ma Compagnie
# SPDX-License-Identifier: Apache-2.0

config HW_STACK_PROTECTION
	default ARCH_HAS_STACK_PROTECTION

if SPI_NOR

config SPI_NOR_FLASH_LAYOUT_PAGE_SIZE
	default 4096 if MCUBOOT || BOOTLOADER_MCUBOOT

endif # SPI_NOR

if BOARD_ISP2454_LX_TB_NRF54L15_CPUAPP_NS || \
   BOARD_ISP2454_LX_TB_MX_NRF54L15_CPUAPP_NS || \
   BOARD_ISP2454_LX_TB_RN_NRF54L15_CPUAPP_NS || \
   BOARD_ISP2454_LP_TB_MX_NRF54L15_CPUAPP_NS || \
   BOARD_ISP2454_LP_TB_RN_NRF54L15_CPUAPP_NS

config HAS_BT_CTLR
	default BT

# Non-Secure builds use TF-M as the Secure Execution Environment by default.
config BUILD_WITH_TFM
	default y

endif # *_NS
```

## boards/insightsip/isp2454/Kconfig.isp2454_lp_tb_mx
```kconfig
# Copyright (c) 2026 Ma Compagnie
# SPDX-License-Identifier: Apache-2.0

config BOARD_ISP2454_LP_TB_MX
	select SOC_NRF54L15_CPUAPP if BOARD_ISP2454_LP_TB_MX_NRF54L15_CPUAPP || \
				      BOARD_ISP2454_LP_TB_MX_NRF54L15_CPUAPP_NS
	select USE_DT_CODE_PARTITION if BOARD_ISP2454_LP_TB_MX_NRF54L15_CPUAPP_NS
```

## boards/insightsip/isp2454/Kconfig.isp2454_lp_tb_rn
```kconfig
# Copyright (c) 2026 Ma Compagnie
# SPDX-License-Identifier: Apache-2.0

config BOARD_ISP2454_LP_TB_RN
	select SOC_NRF54L15_CPUAPP if BOARD_ISP2454_LP_TB_RN_NRF54L15_CPUAPP || \
				      BOARD_ISP2454_LP_TB_RN_NRF54L15_CPUAPP_NS
	select USE_DT_CODE_PARTITION if BOARD_ISP2454_LP_TB_RN_NRF54L15_CPUAPP_NS
```

## boards/insightsip/isp2454/board.yml
```yaml
boards:
  - name: isp2454_lx_tb
    full_name: ISP2454-LX Test Board (without external flash)
    vendor: insightsip
    socs:
      - name: nrf54l15
        variants:
          - name: ns
            cpucluster: cpuapp
  - name: isp2454_lx_tb_mx
    full_name: ISP2454-LX Test Board (Macronix flash)
    vendor: insightsip
    socs:
      - name: nrf54l15
        variants:
          - name: ns
            cpucluster: cpuapp
  - name: isp2454_lx_tb_rn
    full_name: ISP2454-LX Test Board (Renesas flash)
    vendor: insightsip
    socs:
      - name: nrf54l15
        variants:
          - name: ns
            cpucluster: cpuapp
  - name: isp2454_lp_tb_mx
    full_name: ISP2454-LP Test Board (Macronix flash)
    vendor: insightsip
    socs:
      - name: nrf54l15
        variants:
          - name: ns
            cpucluster: cpuapp
  - name: isp2454_lp_tb_rn
    full_name: ISP2454-LP Test Board (Renesas flash)
    vendor: insightsip
    socs:
      - name: nrf54l15
        variants:
          - name: ns
            cpucluster: cpuapp
runners:
  run_once:
    '--recover':
      - runners:
          - nrfjprog
          - nrfutil
        run: first
        groups:
          - boards:
              - isp2454_lx_tb/nrf54l15/cpuapp
              - isp2454_lx_tb/nrf54l15/cpuapp/ns
              - isp2454_lx_tb_mx/nrf54l15/cpuapp
              - isp2454_lx_tb_mx/nrf54l15/cpuapp/ns
              - isp2454_lx_tb_rn/nrf54l15/cpuapp
              - isp2454_lx_tb_rn/nrf54l15/cpuapp/ns
              - isp2454_lp_tb_mx/nrf54l15/cpuapp
              - isp2454_lp_tb_mx/nrf54l15/cpuapp/ns
              - isp2454_lp_tb_rn/nrf54l15/cpuapp
              - isp2454_lp_tb_rn/nrf54l15/cpuapp/ns
    '--erase':
      - runners:
          - nrfjprog
          - jlink
          - nrfutil
        run: first
        groups:
          - boards:
              - isp2454_lx_tb/nrf54l15/cpuapp
              - isp2454_lx_tb/nrf54l15/cpuapp/ns
              - isp2454_lx_tb_mx/nrf54l15/cpuapp
              - isp2454_lx_tb_mx/nrf54l15/cpuapp/ns
              - isp2454_lx_tb_rn/nrf54l15/cpuapp
              - isp2454_lx_tb_rn/nrf54l15/cpuapp/ns
              - isp2454_lp_tb_mx/nrf54l15/cpuapp
              - isp2454_lp_tb_mx/nrf54l15/cpuapp/ns
              - isp2454_lp_tb_rn/nrf54l15/cpuapp
              - isp2454_lp_tb_rn/nrf54l15/cpuapp/ns
    '--reset':
      - runners:
          - nrfjprog
          - jlink
          - nrfutil
        run: last
        groups:
          - boards:
              - isp2454_lx_tb/nrf54l15/cpuapp
              - isp2454_lx_tb/nrf54l15/cpuapp/ns
              - isp2454_lx_tb_mx/nrf54l15/cpuapp
              - isp2454_lx_tb_mx/nrf54l15/cpuapp/ns
              - isp2454_lx_tb_rn/nrf54l15/cpuapp
              - isp2454_lx_tb_rn/nrf54l15/cpuapp/ns
              - isp2454_lp_tb_mx/nrf54l15/cpuapp
              - isp2454_lp_tb_mx/nrf54l15/cpuapp/ns
              - isp2454_lp_tb_rn/nrf54l15/cpuapp
              - isp2454_lp_tb_rn/nrf54l15/cpuapp/ns
```

## boards/insightsip/isp2454/isp2454_lx_tb_mx_nrf54l15_cpuapp_defconfig
```kconfig
# Copyright (c) 2026 Ma Compagnie
# SPDX-License-Identifier: Apache-2.0

CONFIG_SERIAL=y
CONFIG_CONSOLE=y
CONFIG_UART_CONSOLE=y
CONFIG_GPIO=y
CONFIG_ARM_MPU=y

# Flash externe
CONFIG_SPI=y
CONFIG_FLASH=y
CONFIG_SPI_NOR=y
```

## samples/matter/light_bulb/sample.yaml
```yaml
sample:
  description: Matter Light Bulb sample for ISP2454 modules
  name: ISP Matter Light Bulb
common:
  tags:
    - sysbuild
    - ci_samples_matter
tests:
  sample.matter.light_bulb.debug:
    sysbuild: true
    build_only: true
    integration_platforms:
      - isp2454_lx_tb_mx/nrf54l15/cpuapp
    platform_allow:
      - isp2454_lx_tb_mx/nrf54l15/cpuapp
      - isp2454_lx_tb_rn/nrf54l15/cpuapp
      - isp2454_lp_tb_mx/nrf54l15/cpuapp
      - isp2454_lp_tb_rn/nrf54l15/cpuapp
  sample.matter.light_bulb.release:
    sysbuild: true
    build_only: true
    extra_args:
      - FILE_SUFFIX=release
    integration_platforms:
      - isp2454_lx_tb_mx/nrf54l15/cpuapp
    platform_allow:
      - isp2454_lx_tb_mx/nrf54l15/cpuapp
      - isp2454_lx_tb_rn/nrf54l15/cpuapp
      - isp2454_lp_tb_mx/nrf54l15/cpuapp
      - isp2454_lp_tb_rn/nrf54l15/cpuapp
  sample.matter.light_bulb.tfm:
    sysbuild: true
    build_only: true
    extra_args:
      - FILE_SUFFIX=tfm
    integration_platforms:
      - isp2454_lx_tb_mx/nrf54l15/cpuapp/ns
    platform_allow:
      - isp2454_lx_tb_mx/nrf54l15/cpuapp/ns
      - isp2454_lx_tb_rn/nrf54l15/cpuapp/ns
      - isp2454_lp_tb_mx/nrf54l15/cpuapp/ns
      - isp2454_lp_tb_rn/nrf54l15/cpuapp/ns
```

## samples/matter/lock/sample.yaml
```yaml
sample:
  description: Matter Door Lock sample for ISP2454 modules
  name: ISP Matter Door Lock
common:
  tags:
    - sysbuild
    - ci_samples_matter
tests:
  sample.matter.lock.debug:
    sysbuild: true
    build_only: true
    integration_platforms:
      - isp2454_lx_tb_mx/nrf54l15/cpuapp
    platform_allow:
      - isp2454_lx_tb_mx/nrf54l15/cpuapp
      - isp2454_lx_tb_rn/nrf54l15/cpuapp
      - isp2454_lp_tb_mx/nrf54l15/cpuapp
      - isp2454_lp_tb_rn/nrf54l15/cpuapp
  sample.matter.lock.release:
    sysbuild: true
    build_only: true
    extra_args:
      - FILE_SUFFIX=release
    integration_platforms:
      - isp2454_lx_tb_mx/nrf54l15/cpuapp
    platform_allow:
      - isp2454_lx_tb_mx/nrf54l15/cpuapp
      - isp2454_lx_tb_rn/nrf54l15/cpuapp
      - isp2454_lp_tb_mx/nrf54l15/cpuapp
      - isp2454_lp_tb_rn/nrf54l15/cpuapp
  sample.matter.lock.tfm:
    sysbuild: true
    build_only: true
    extra_args:
      - FILE_SUFFIX=tfm
    integration_platforms:
      - isp2454_lx_tb_mx/nrf54l15/cpuapp/ns
    platform_allow:
      - isp2454_lx_tb_mx/nrf54l15/cpuapp/ns
      - isp2454_lx_tb_rn/nrf54l15/cpuapp/ns
      - isp2454_lp_tb_mx/nrf54l15/cpuapp/ns
      - isp2454_lp_tb_rn/nrf54l15/cpuapp/ns
  sample.matter.lock.schedules:
    sysbuild: true
    build_only: true
    extra_args:
      - EXTRA_CONF_FILE=schedules.conf
    integration_platforms:
      - isp2454_lx_tb_mx/nrf54l15/cpuapp
    platform_allow:
      - isp2454_lx_tb_mx/nrf54l15/cpuapp
      - isp2454_lx_tb_rn/nrf54l15/cpuapp
      - isp2454_lp_tb_mx/nrf54l15/cpuapp
      - isp2454_lp_tb_rn/nrf54l15/cpuapp
```

## samples/matter/thermostat/sample.yaml
```yaml
sample:
  description: Matter Thermostat sample for ISP2454 modules
  name: ISP Matter Thermostat
common:
  tags:
    - sysbuild
    - ci_samples_matter
tests:
  sample.matter.thermostat.debug:
    sysbuild: true
    build_only: true
    integration_platforms:
      - isp2454_lx_tb_mx/nrf54l15/cpuapp
    platform_allow:
      - isp2454_lx_tb_mx/nrf54l15/cpuapp
      - isp2454_lx_tb_rn/nrf54l15/cpuapp
      - isp2454_lp_tb_mx/nrf54l15/cpuapp
      - isp2454_lp_tb_rn/nrf54l15/cpuapp
  sample.matter.thermostat.release:
    sysbuild: true
    build_only: true
    extra_args:
      - FILE_SUFFIX=release
    integration_platforms:
      - isp2454_lx_tb_mx/nrf54l15/cpuapp
    platform_allow:
      - isp2454_lx_tb_mx/nrf54l15/cpuapp
      - isp2454_lx_tb_rn/nrf54l15/cpuapp
      - isp2454_lp_tb_mx/nrf54l15/cpuapp
      - isp2454_lp_tb_rn/nrf54l15/cpuapp
  sample.matter.thermostat.tfm:
    sysbuild: true
    build_only: true
    extra_args:
      - FILE_SUFFIX=tfm
    integration_platforms:
      - isp2454_lx_tb_mx/nrf54l15/cpuapp/ns
    platform_allow:
      - isp2454_lx_tb_mx/nrf54l15/cpuapp/ns
      - isp2454_lx_tb_rn/nrf54l15/cpuapp/ns
      - isp2454_lp_tb_mx/nrf54l15/cpuapp/ns
      - isp2454_lp_tb_rn/nrf54l15/cpuapp/ns
```
