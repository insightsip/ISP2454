/*
 * Copyright (c) 2026 Ma Compagnie
 * SPDX-License-Identifier: Apache-2.0
 *
 * Partie non-secure (TF-M). Le .dts doit :
 *   - définir USE_NON_SECURE_ADDRESS_MAP et inclure <arm/nordic/nrf54l15_cpuapp_ns.dtsi> AVANT
 *   - inclure ensuite, EN DERNIER : <vendor/nordic/nrf54l15_cpuapp_ns_partition.dtsi>
 */

/ {
	chosen {
		zephyr,code-partition = &slot0_ns_partition;
		zephyr,sram = &sram0_ns;
		zephyr,entropy = &psa_rng;
	};

	/delete-node/ rng;

	psa_rng: psa-rng {
		status = "okay";
	};
};

&uart30 {
	/* Disabled so that TF-M can use this UART */
	status = "disabled";

	current-speed = <115200>;
	pinctrl-0 = <&uart30_default>;
	pinctrl-1 = <&uart30_sleep>;
	pinctrl-names = "default", "sleep";
};
