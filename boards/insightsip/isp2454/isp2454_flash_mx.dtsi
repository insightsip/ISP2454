/*
 * Copyright (c) 2026 Ma Compagnie
 * SPDX-License-Identifier: Apache-2.0
 */

&spi00 {
	status = "okay";

	ext_flash: mx25r3235f@0 {
		compatible = "jedec,spi-nor";
		status = "okay";
		reg = <0>;
		spi-max-frequency = <8000000>;

		jedec-id = [c2 28 16];
		sfdp-bfp = [
			e5 20 f1 ff  ff ff ff 01  44 eb 08 6b  08 3b 04 bb
			ee ff ff ff  ff ff 00 ff  ff ff 00 ff  0c 20 0f 52
			10 d8 00 ff  23 72 f5 00  82 ed 04 c6  44 83 48 44
			30 b0 30 b0  f7 c4 d5 5c  00 be 29 ff  f0 d0 ff ff
		];
		size = <33554432>;
		has-dpd;
		t-enter-dpd = <10000>;
		t-exit-dpd = <35000>;
	};
};

/ {
	chosen {
		nordic,pm-ext-flash = &ext_flash;
	};
};
