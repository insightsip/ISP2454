/*
 * Copyright (c) 2026 Ma Compagnie
 * SPDX-License-Identifier: Apache-2.0
 *
 * Partie secure. Le .dts doit inclure ensuite, EN DERNIER :
 *   #include <vendor/nordic/nrf54l15_cpuapp_partition.dtsi>
 */

/ {
	chosen {
		zephyr,code-partition = &slot0_partition;
		zephyr,sram = &cpuapp_sram;
	};
};
