## CMakeLists.txt
```
# SPDX-License-Identifier: Apache-2.0
#
# Standalone SPI-NOR flash test app - adapted from
# zephyr/samples/drivers/spi_flash to bring up/verify the external flash of
# the ISP2454 test boards in isolation from the Matter applications.
#
# The ISP2454 boards are provided by this repository's Zephyr module
# (zephyr/module.yml, board_root: .), so no BOARD_ROOT is needed here.

cmake_minimum_required(VERSION 3.20.0)

find_package(Zephyr REQUIRED HINTS $ENV{ZEPHYR_BASE})
project(spi_flash)

FILE(GLOB app_sources src/*.c)
target_sources(app PRIVATE ${app_sources})
```

## sample.yaml
```
sample:
  description: External SPI-NOR flash test for ISP2454 test boards
  name: ISP SPI Flash
common:
  tags:
    - drivers
    - flash
    - spi
tests:
  sample.drivers.spi_flash.isp2454:
    integration_platforms:
      - isp2454_lx_tb_mx/nrf54l15/cpuapp
    platform_allow:
      - isp2454_lx_tb_mx/nrf54l15/cpuapp
      - isp2454_lx_tb_rn/nrf54l15/cpuapp
      - isp2454_lp_tb_mx/nrf54l15/cpuapp
      - isp2454_lp_tb_rn/nrf54l15/cpuapp
    harness: console
    harness_config:
      type: multi_line
      ordered: true
      regex:
        - "Flash erase succeeded!"
        - "Data read matches data written. Good!!"
```

## prj.conf
```kconfig
# SPI-NOR flash test app for the ISP2454 test boards
# (AT25FF321A on *_rn boards, MX25R3235F on *_mx boards).

CONFIG_STDOUT_CONSOLE=y
CONFIG_FLASH=y

# Already enabled by the ISP2454 board defconfigs, repeated here so the
# sample states everything it depends on.
CONFIG_GPIO=y
CONFIG_SPI=y
CONFIG_SPI_NOR=y

# The ext_flash devicetree node carries an explicit sfdp-bfp property
# (see boards/insightsip/isp2454/isp2454_flash_{mx,rn}.dtsi) - read SFDP from
# devicetree rather than querying the chip at runtime.
CONFIG_SPI_NOR_SFDP_DEVICETREE=y
```

## src/main.c
```c
/*
 * Copyright (c) 2016 Intel Corporation.
 *
 * SPDX-License-Identifier: Apache-2.0
 */

#include <zephyr/kernel.h>
#include <zephyr/drivers/flash.h>
#include <zephyr/device.h>
#include <zephyr/devicetree.h>
#include <stdio.h>
#include <string.h>

#if defined(CONFIG_BOARD_ISP2454_LX_TB_MX) || defined(CONFIG_BOARD_ISP2454_LX_TB_RN) || \
	defined(CONFIG_BOARD_ISP2454_LP_TB_MX) || defined(CONFIG_BOARD_ISP2454_LP_TB_RN)
/* Last 4 KB sector of the external flash ("size" is in bits), so the test
 * stays clear of the MCUboot secondary slot used by the Matter samples.
 */
#define SPI_FLASH_TEST_REGION_OFFSET (DT_PROP(DT_NODELABEL(ext_flash), size) / 8 - 4096)
#elif defined(CONFIG_BOARD_ADAFRUIT_FEATHER_STM32F405)
#define SPI_FLASH_TEST_REGION_OFFSET 0xf000
#elif defined(CONFIG_BOARD_ARTY_A7_DESIGNSTART_FPGA_CORTEX_M1) || \
	defined(CONFIG_BOARD_ARTY_A7_DESIGNSTART_FPGA_CORTEX_M3)
/* The FPGA bitstream is stored in the lower 536 sectors of the flash. */
#define SPI_FLASH_TEST_REGION_OFFSET \
	DT_REG_SIZE(DT_NODE_BY_FIXED_PARTITION_LABEL(fpga_bitstream))
#elif defined(CONFIG_BOARD_NPCX9M6F_EVB) || \
	defined(CONFIG_BOARD_NPCX7M6FB_EVB)
#define SPI_FLASH_TEST_REGION_OFFSET 0x7F000
#elif defined(CONFIG_BOARD_EK_RA8M1) || defined(CONFIG_BOARD_EK_RA8D1)
#define SPI_FLASH_TEST_REGION_OFFSET 0x40000
#elif DT_HAS_COMPAT_STATUS_OKAY(st_stm32_qspi_nor) && DT_PROP(DT_NODELABEL(quadspi), dual_flash)
#define SPI_FLASH_TEST_REGION_OFFSET 0xfe000
#else
#define SPI_FLASH_TEST_REGION_OFFSET 0xf1000
#endif
#if defined(CONFIG_BOARD_EK_RA8M1) || defined(CONFIG_BOARD_EK_RA8D1)
#define SPI_FLASH_SECTOR_SIZE 262144
#elif DT_HAS_COMPAT_STATUS_OKAY(st_stm32_qspi_nor) && DT_PROP(DT_NODELABEL(quadspi), dual_flash)
#define SPI_FLASH_SECTOR_SIZE 8192
#else
#define SPI_FLASH_SECTOR_SIZE        4096
#endif

#if defined(CONFIG_FLASH_STM32_OSPI) || defined(CONFIG_FLASH_STM32_QSPI) ||                        \
	defined(CONFIG_FLASH_STM32_XSPI) || defined(CONFIG_FLASH_RENESAS_RA_OSPI_B) ||             \
	defined(CONFIG_FLASH_RENESAS_RA_QSPI) || defined(CONFIG_FLASH_RENESAS_RZ_QSPI_XSPI) ||     \
	defined(CONFIG_FLASH_RENESAS_RZ_QSPI_SPIBSC)
#define SPI_FLASH_MULTI_SECTOR_TEST
#endif

#if DT_HAS_COMPAT_STATUS_OKAY(jedec_spi_nor)
#define SPI_FLASH_COMPAT jedec_spi_nor
#elif DT_HAS_COMPAT_STATUS_OKAY(jedec_mspi_nor)
#define SPI_FLASH_COMPAT jedec_mspi_nor
#elif DT_HAS_COMPAT_STATUS_OKAY(st_stm32_qspi_nor)
#define SPI_FLASH_COMPAT st_stm32_qspi_nor
#elif DT_HAS_COMPAT_STATUS_OKAY(st_stm32_ospi_nor)
#define SPI_FLASH_COMPAT st_stm32_ospi_nor
#elif DT_HAS_COMPAT_STATUS_OKAY(st_stm32_xspi_nor)
#define SPI_FLASH_COMPAT st_stm32_xspi_nor
#elif DT_HAS_COMPAT_STATUS_OKAY(nordic_qspi_nor)
#define SPI_FLASH_COMPAT nordic_qspi_nor
#elif DT_HAS_COMPAT_STATUS_OKAY(renesas_ra_ospi_b_nor)
#define SPI_FLASH_COMPAT renesas_ra_ospi_b_nor
#elif DT_HAS_COMPAT_STATUS_OKAY(renesas_ra_qspi_nor)
#define SPI_FLASH_COMPAT renesas_ra_qspi_nor
#elif DT_HAS_COMPAT_STATUS_OKAY(renesas_rz_qspi_xspi)
#define SPI_FLASH_COMPAT renesas_rz_qspi_xspi
#elif DT_HAS_COMPAT_STATUS_OKAY(renesas_rz_qspi_spibsc)
#define SPI_FLASH_COMPAT renesas_rz_qspi_spibsc
#elif DT_HAS_COMPAT_STATUS_OKAY(nxp_xspi_nor)
#define SPI_FLASH_COMPAT nxp_xspi_nor
#elif DT_HAS_COMPAT_STATUS_OKAY(nxp_imx_flexspi_nor)
#define SPI_FLASH_COMPAT nxp_imx_flexspi_nor
#else
#define SPI_FLASH_COMPAT invalid
#endif

#if defined(CONFIG_FLASH_RENESAS_RA_OSPI_B)
const uint8_t erased[] = {0xff, 0xff, 0xff, 0xff, 0xff, 0xff, 0xff, 0xff};
#else
const uint8_t erased[] = { 0xff, 0xff, 0xff, 0xff };
#endif

void single_sector_test(const struct device *flash_dev)
{
#if defined(CONFIG_FLASH_RENESAS_RA_OSPI_B)
	const uint8_t expected[] = {0x00, 0x01, 0x02, 0x03, 0x04, 0x05, 0x06, 0x07};
#else
	const uint8_t expected[] = { 0x55, 0xaa, 0x66, 0x99 };
	const uint8_t test_data[] = { 0x1a, 0x2b, 0xf, 0x0d, 0x3c, 0x4e, 0x5f, 0x6a };
	const size_t len1 = sizeof(test_data);
	uint8_t buf1[sizeof(test_data)];
#endif
	const size_t len = sizeof(expected);
	uint8_t buf[sizeof(expected)];
	int rc;

	printf("\nPerform test on single sector");
	/* Write protection needs to be disabled before each write or
	 * erase, since the flash component turns on write protection
	 * automatically after completion of write and erase
	 * operations.
	 */
	printf("\nTest 1: Flash erase\n");

	/* Full flash erase if SPI_FLASH_TEST_REGION_OFFSET = 0 and
	 * SPI_FLASH_SECTOR_SIZE = flash size
	 */
	rc = flash_erase(flash_dev, SPI_FLASH_TEST_REGION_OFFSET,
			 SPI_FLASH_SECTOR_SIZE);
	if (rc != 0) {
		printf("Flash erase failed! %d\n", rc);
	} else {
		/* Check erased pattern */
		memset(buf, 0, len);
		rc = flash_read(flash_dev, SPI_FLASH_TEST_REGION_OFFSET, buf, len);
		if (rc != 0) {
			printf("Flash read failed! %d\n", rc);
			return;
		}
		if (memcmp(erased, buf, len) != 0) {
			printf("Flash erase failed at offset 0x%x got 0x%x\n",
				SPI_FLASH_TEST_REGION_OFFSET, *(uint32_t *)buf);
			return;
		}
		printf("Flash erase succeeded!\n");
	}
	printf("\nTest 2: Flash write\n");

	printf("Attempting to write %zu bytes\n", len1);
	rc = flash_write(flash_dev, SPI_FLASH_TEST_REGION_OFFSET, test_data, len1);
	if (rc != 0) {
		printf("Flash write failed! %d\n", rc);
		return;
	}

	memset(buf1, 0, len1);
	rc = flash_read(flash_dev, SPI_FLASH_TEST_REGION_OFFSET, buf1, len1);
	if (rc != 0) {
		printf("Flash read failed! %d\n", rc);
		return;
	}

	if (memcmp(test_data, buf1, len1) == 0) {
		printf("Data read matches data written. Good!!\n");
	} else {
		const uint8_t *wp = test_data;
		const uint8_t *rp = buf1;
		const uint8_t *rpe = rp + len1;

		printf("Data read does not match data written!!\n");
		while (rp < rpe) {
			printf("%08x wrote %02x read %02x %s\n",
			       (uint32_t)(SPI_FLASH_TEST_REGION_OFFSET + (rp - buf1)),
			       *wp, *rp, (*rp == *wp) ? "match" : "MISMATCH");
			++rp;
			++wp;
		}
	}
}

#if defined SPI_FLASH_MULTI_SECTOR_TEST
void multi_sector_test(const struct device *flash_dev)
{
#if defined(CONFIG_FLASH_RENESAS_RA_OSPI_B)
	const uint8_t expected[] = {0x00, 0x01, 0x02, 0x03, 0x04, 0x05, 0x06, 0x07};
#else
	const uint8_t expected[] = { 0x55, 0xaa, 0x66, 0x99 };
#endif
	const size_t len = sizeof(expected);
	uint8_t buf[sizeof(expected)];
	int rc;

	printf("\nPerform test on multiple consecutive sectors");

	/* Write protection needs to be disabled before each write or
	 * erase, since the flash component turns on write protection
	 * automatically after completion of write and erase
	 * operations.
	 */
	printf("\nTest 1: Flash erase\n");

	/* Full flash erase if SPI_FLASH_TEST_REGION_OFFSET = 0 and
	 * SPI_FLASH_SECTOR_SIZE = flash size
	 * Erase 2 sectors for check for erase of consequtive sectors
	 */
	rc = flash_erase(flash_dev, SPI_FLASH_TEST_REGION_OFFSET, SPI_FLASH_SECTOR_SIZE * 2);
	if (rc != 0) {
		printf("Flash erase failed! %d\n", rc);
	} else {
		/* Read the content and check for erased */
		memset(buf, 0, len);
		size_t offs = SPI_FLASH_TEST_REGION_OFFSET;

		while (offs < SPI_FLASH_TEST_REGION_OFFSET + 2 * SPI_FLASH_SECTOR_SIZE) {
			rc = flash_read(flash_dev, offs, buf, len);
			if (rc != 0) {
				printf("Flash read failed! %d\n", rc);
				return;
			}
			if (memcmp(erased, buf, len) != 0) {
				printf("Flash erase failed at offset 0x%x got 0x%x\n",
				offs, *(uint32_t *)buf);
				return;
			}
			offs += SPI_FLASH_SECTOR_SIZE;
		}
		printf("Flash erase succeeded!\n");
	}

	printf("\nTest 2: Flash write\n");

	size_t offs = SPI_FLASH_TEST_REGION_OFFSET;

	while (offs < SPI_FLASH_TEST_REGION_OFFSET + 2 * SPI_FLASH_SECTOR_SIZE) {
		printf("Attempting to write %zu bytes at offset 0x%x\n", len, offs);
		rc = flash_write(flash_dev, offs, expected, len);
		if (rc != 0) {
			printf("Flash write failed! %d\n", rc);
			return;
		}

		memset(buf, 0, len);
		rc = flash_read(flash_dev, offs, buf, len);
		if (rc != 0) {
			printf("Flash read failed! %d\n", rc);
			return;
		}

		if (memcmp(expected, buf, len) == 0) {
			printf("Data read matches data written. Good!!\n");
		} else {
			const uint8_t *wp = expected;
			const uint8_t *rp = buf;
			const uint8_t *rpe = rp + len;

			printf("Data read does not match data written!!\n");
			while (rp < rpe) {
				printf("%08x wrote %02x read %02x %s\n",
					(uint32_t)(offs + (rp - buf)),
					*wp, *rp, (*rp == *wp) ? "match" : "MISMATCH");
				++rp;
				++wp;
			}
		}
		offs += SPI_FLASH_SECTOR_SIZE;
	}
}
#endif

int main(void)
{
	const struct device *flash_dev = DEVICE_DT_GET_ONE(SPI_FLASH_COMPAT);

	if (!device_is_ready(flash_dev)) {
		printk("%s: device not ready.\n", flash_dev->name);
		return 0;
	}

	printf("\n%s SPI flash testing\n", flash_dev->name);
	printf("==========================\n");

	single_sector_test(flash_dev);
#if defined SPI_FLASH_MULTI_SECTOR_TEST
	multi_sector_test(flash_dev);
#endif
	return 0;
}
```
